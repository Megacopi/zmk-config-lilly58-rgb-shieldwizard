## boards/shields/lilly58/Kconfig.shield
```kconfig
config SHIELD_LILLY58_LEFT
    def_bool $(shields_list_contains,lilly58_left)
  
config SHIELD_LILLY58_RIGHT
    def_bool $(shields_list_contains,lilly58_right)
  
```
